## anycloud39ev300/SDK/component/wifi/ssv6x5x/smac/firmware/defconfig/defconfig
```kconfig
##############################################################################
# Sample file for project configuration. This file will be copied
# to .config in the top directory and be parsed by genconf.sh to
# generate config.h
##############################################################################

CONFIG_TARGET = cabrio
CONFIG_HCI = sw
CONFIG_CFLAGS = IGNORE_CHIP_ID		

#####################################################################
# BSP & CPU Configurations
#####################################################################
CONFIG_SYS_CLK = 40                     # CPU 40MHz
CONFIG_TICK_HZ = 100                    # 1 tick=100Hz=1ms
CONFIG_IRQ_STACK_SIZE = 256             # IRQ stack size
CONFIG_ENABLE_CPU_UART = y		# Enable/Disable CPU UART
CONFIG_CPU_UART_BR = 115200		# CPU UART Baud Rate
```
